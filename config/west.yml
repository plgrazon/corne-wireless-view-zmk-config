## config/west.yml
```yaml
manifest:
  remotes:
    - name: zmkfirmware
      url-base: https://github.com/zmkfirmware
    - name: zmkfirmware-pete
      url-base: https://github.com/petejohanson
  projects:
    - name: zmk
      remote: zmkfirmware
      # revision: main
      revision: feat/pointers-move-scroll
      import: app/west.yml
  self:
    path: config
```
